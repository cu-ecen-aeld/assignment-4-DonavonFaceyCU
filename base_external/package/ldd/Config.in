## base_external/package/ldd/Config.in
```kconfig
config BR2_PACKAGE_LDD
	bool "ldd"
	help
	  Includes the ldd example drivers updated for current kernel versions.
	  Used for building and installing misc-modules and scull packages to image.
```
